## firmware/boards/shields/gullwing/Kconfig.defconfig
```kconfig
# Copyright (c) 2022 The ZMK Contributors
# SPDX-License-Identifier: MIT

# Sets some initial defaults when build keyboard

if SHIELD_GULLWING

config ZMK_KEYBOARD_NAME
    default "Gullwing"

config ZMK_SPLIT_ROLE_CENTRAL
    default y

config ZMK_USB
    default y

config I2C
  default y

endif # SHIELD_GULLWING
```

## firmware/config/west.yml
```yaml
manifest:
  remotes:
    - name: zmkfirmware
      url-base: https://github.com/zmkfirmware
    - name: petejohanson
      url-base: https://github.com/petejohanson/
    - name: nmunnich
      url-base: https://github.com/nmunnich/zmk-component-rp2040-zero
  projects:
    - name: zmk
      remote: zmkfirmware
      revision: main
      import: app/west.yml
    - name: zmk-component-rp2040-zero 
      remote: nmunnich
      revision: main
  self:
    path: config
```
